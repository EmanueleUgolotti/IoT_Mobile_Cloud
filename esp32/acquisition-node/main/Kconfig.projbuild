## esp32/acquisition-node/main/Kconfig.projbuild
```kconfig
menu "BPA Acquisition Node Configuration"

    config BPA_WIFI_SSID
        string "Nome rete WiFi (SSID)"
        default "changeme"
        help
            Deve essere la STESSA rete a cui e' connesso il Gateway
            (ESP32 #2) - non serve per accedere a Internet da qui, ma
            ESP-NOW richiede che i due dispositivi siano sullo stesso
            canale radio, e collegarsi alla stessa rete e' il modo piu'
            semplice per garantirlo.

    config BPA_WIFI_PASSWORD
        string "Password rete WiFi"
        default "changeme"

    config BPA_GATEWAY_MAC_ADDR
        string "Indirizzo MAC del Gateway (ESP32 #2)"
        default "DC:B4:D9:09:FB:20"
        help
            Stampato dal firmware del Gateway al suo avvio ("Indirizzo
            MAC di questo Gateway: ..."). Va copiato qui esattamente,
            con i due punti come separatori.

    config BPA_NODE_ID
        int "ID di questo nodo"
        default 1
        help
            Deve corrispondere al node_id atteso dal Gateway/backend
            (finora sempre usato 1 nei test).

    config BPA_SEND_INTERVAL_MS
        int "Intervallo tra un invio e il successivo (millisecondi)"
        default 10000
        help
            Ogni quanto il nodo manda un nuovo pacchetto 'reference' al
            Gateway, scegliendo la prossima immagine del dataset a
            rotazione (a meno che BPA_SINGLE_IMAGE_REF non sia
            impostato, vedi sotto).

    config BPA_SINGLE_IMAGE_REF
        string "Manda sempre solo questa immagine (lascia vuoto per la rotazione)"
        default ""
        help
            Se vuoto (default), il nodo manda a rotazione tutte le
            immagini della lista DATASET_IMAGES in main.c. Se qui
            scrivi un nome file (es. "Hf73.jpg"), il nodo mandera'
            SEMPRE e SOLO quella, ignorando la rotazione - utile per
            test mirati su un'unica immagine.

    config BPA_AUTO_SEND_ENABLED_AT_BOOT
        bool "Modalita' automatica attiva gia' all'avvio"
        default y
        help
            Se attivo (default), il nodo manda automaticamente un
            pacchetto ogni BPA_SEND_INTERVAL_MS fin dall'avvio - stesso
            comportamento di prima. Se disattivo, la modalita'
            automatica parte spenta, e va accesa manualmente con il
            pulsante MENU (vedi sotto) - lo scatto manuale con PLAY resta
            comunque sempre disponibile in entrambi i casi.

endmenu
```

## esp32/gateway/main/Kconfig.projbuild
```kconfig
menu "BPA Gateway Configuration"

    config BPA_WIFI_SSID
        string "Nome rete WiFi (SSID)"
        default "changeme"
        help
            Nome della rete WiFi a cui il Gateway si connette per
            raggiungere Mobile/Cloud via HTTP. Cambia con "idf.py
            menuconfig" ogni volta che cambi rete, senza dover
            modificare il codice sorgente.
            NOTA: reti pubbliche con portale di accesso via browser
            (es. WiFi cittadini/regionali) NON funzionano - l'ESP32 non
            puo' gestire quel tipo di autenticazione. Usa una rete
            domestica o l'hotspot di un telefono.

    config BPA_WIFI_PASSWORD
        string "Password rete WiFi"
        default "changeme"

    config BPA_CLOUD_HOST
        string "Indirizzo IP del backend Cloud"
        default "192.168.1.100"
        help
            IP del PC/server dove gira "docker compose up" (servizio
            api, porta 8000 di default).

    config BPA_CLOUD_PORT
        int "Porta del backend Cloud"
        default 8000

    config BPA_MOBILE_HOST
        string "Indirizzo IP del telefono (modalita' Mobile)"
        default "192.168.1.101"
        help
            IP del telefono quando l'app e' in ascolto (porta 8080 di
            default, vedi Impostazioni dell'app).

    config BPA_MOBILE_PORT
        int "Porta del telefono"
        default 8080

    config BPA_API_KEY
        string "API key (lascia vuoto se AUTH_ENABLED=false sul backend)"
        default ""

    config BPA_SELFTEST_SEND_DUMMY_PACKET
        bool "Invia un pacchetto di prova finto all'avvio (test senza Acquisition Node)"
        default n
        help
            Utile per testare la logica di offloading/inoltro HTTP prima
            che l'Acquisition Node sia disponibile: all'avvio, genera un
            pacchetto finto identico a uno vero e lo fa passare per lo
            stesso identico percorso di codice usato per un pacchetto
            ESP-NOW reale. Disattiva questa opzione quando l'Acquisition
            Node sara' pronto, per non generare traffico finto insieme
            a quello vero.

endmenu
```
